## configs/linuxpba_defconfig
```kconfig
BR2_CCACHE=y
BR2_ENABLE_SSP=y
BR2_UCLIBC_CONFIG="board/cra/linuxpba/uclibc.config"
BR2_TOOLCHAIN_BUILDROOT_USE_SSP=y
# BR2_UCLIBC_INSTALL_UTILS is not set
BR2_TOOLCHAIN_BUILDROOT_CXX=y
# BR2_TARGET_GENERIC_GETTY is not set
BR2_ROOTFS_OVERLAY="board/cra/linuxpba/fs-overlay"
BR2_ROOTFS_POST_BUILD_SCRIPT="board/cra/linuxpba/post-build.sh"
BR2_ROOTFS_POST_IMAGE_SCRIPT="board/cra/linuxpba/post-image.sh"
BR2_LINUX_KERNEL=y
BR2_LINUX_KERNEL_USE_CUSTOM_CONFIG=y
BR2_LINUX_KERNEL_CUSTOM_CONFIG_FILE="board/cra/linuxpba/linux.config"
BR2_PACKAGE_BUSYBOX_CONFIG="board/cra/linuxpba/busybox.config"
BR2_PACKAGE_MSED=y
BR2_TARGET_ROOTFS_CPIO=y
BR2_TARGET_ROOTFS_CPIO_GZIP=y
# BR2_TARGET_ROOTFS_TAR is not set
BR2_TARGET_SYSLINUX=y
BR2_TARGET_SYSLINUX_MBR=y
BR2_TARGET_SYSLINUX_C32="ldlinux.sys ldlinux.c32"
BR2_PACKAGE_HOST_DOSFSTOOLS=y
BR2_PACKAGE_HOST_MTOOLS=y
BR2_PACKAGE_HOST_PARTED=y
```

## package/msed/Config.in
```kconfig
config BR2_PACKAGE_MSED
	bool "msed"
	select BR2_PACKAGE_NCURSES
	help
	  Tools to manage the activation and use of self encrypting drives
          that comply with the Trusted Computing Group Opal 2.0 SSC. 

	  http://www.r0m30.com/msed
```
